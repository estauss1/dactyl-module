## boards/shields/dactyl-5x6-oled/Kconfig.defconfig
```kconfig
if SHIELD_DAC_LEFT

# Name must be less than 16 characters long!
config ZMK_KEYBOARD_NAME
    default "Dactyl Manuform"

config ZMK_SPLIT_ROLE_CENTRAL
    default y

endif

if SHIELD_DAC_LEFT || SHIELD_DAC_RIGHT

config ZMK_SPLIT
    default y

if ZMK_DISPLAY

config I2C
    default y

config SSD1306
    default y

endif #zmk_display

endif
```

## boards/shields/dactyl-5x6-oled/Kconfig.shield
```kconfig
# No whitespace after the comma or in your part name!
config SHIELD_DAC_LEFT
    def_bool $(shields_list_contains,dac_left)

# No whitespace after the comma or in your part name!
config SHIELD_DAC_RIGHT
    def_bool $(shields_list_contains,dac_right)
```
